## main/Kconfig.projbuild
```kconfig
menu "Example Configuration"

config EVENT_SERVER_URL
    string "Event Server"
    default "http://server/event"
    help
    Server to which we should send the event

config ESP_WIFI_SSID
    string "WiFi SSID"
    default "myssid"
    help
	SSID (network name) for the example to connect to.

config ESP_WIFI_PASSWORD
    string "WiFi Password"
    default "mypassword"
    help
	WiFi password (WPA or WPA2) for the example to use.
		
config MAX_STA_CONN
    int "Max STA conn"
    default 4
    help
	Max number of the STA connects to AP.
endmenu
```
